#include "common.h"

/*  Defines  */

#define IMG_TITLE_W     64
#define IMG_TITLE_H     16

#define IMG_CURSOR_W    5
#define IMG_CURSOR_H    8
#define IMG_CURSOR_TOP  48

enum : uint8_t {
    SPR_ID_TITLE = 0,
    SPR_ID_CURSOR,
};

/*  Local Variables  */

PROGMEM static const uint8_t imgTitle[128] = { // 64x16
    0xFF, 0xFF, 0xF8, 0xC0, 0xFF, 0xFF, 0x00, 0xF8, 0xF8, 0x00, 0xF8, 0xF8, 0x00, 0xF8, 0xF8, 0x18,
    0xF8, 0xF8, 0x18, 0xF8, 0xF0, 0x00, 0xFF, 0xFF, 0x18, 0xF8, 0xF0, 0x00, 0xF0, 0xF8, 0x18, 0xF8,
    0xF0, 0x00, 0xF8, 0xF8, 0x38, 0x00, 0xFF, 0xFF, 0x03, 0xFF, 0xFE, 0x00, 0xFF, 0xFF, 0x00, 0x70,
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    0xFE, 0xC3, 0xFF, 0xFF, 0x00, 0x7F, 0xFF, 0xC0, 0xF0, 0x70, 0x00, 0x7F, 0xFF, 0xC3, 0xF3, 0x73
};

PROGMEM static const uint8_t imgCursor[5] = { // 5x5
    0x38, 0x7C, 0x7C, 0x7C, 0x38
};

/*---------------------------------------------------------------------------*/

void initTitle(void)
{
    level = LEVEL_MEDIUM;
    setSprite(SPR_ID_TITLE, 32, 24, imgTitle, IMG_TITLE_W, IMG_TITLE_H, DIRECT);
    setSprite(SPR_ID_CURSOR, 43, IMG_CURSOR_TOP, imgCursor, IMG_CURSOR_W, IMG_CURSOR_H, DIRECT);
    setString(8, 13, F("EASY  MEDIUM  HARD"), WHITE);
    isInvalid = true;
}

MODE_T updateTitle(void)
{
    MODE_T ret = MODE_TITLE;
    handleDpad();
    if (dpadX != 0) {
        level = circulate(level, dpadX, (LEVEL_MAX - 1));
        moveSprite(SPR_ID_CURSOR, level * 48 + !level * 12 - 5, IMG_CURSOR_TOP);
        playSoundTick();
        isInvalid = true;
        rand(); // Shuffle random
    }
    if (isButtonDown(A_BUTTON)) {
        if (level == LEVEL_HARD && isButtonPressed(UP_BUTTON)) level = LEVEL_EXPERT; // Secret!!
        ret = MODE_GAME;
    }
    puzzleSeed = rand();
    randomSeed(puzzleSeed); // Shuffle random
    return ret;
}
