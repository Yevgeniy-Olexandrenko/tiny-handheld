#pragma once

#include "src/engine.h"
#include "src/assets/fonts.h"
#include "src/boot.h"

const uint8_t picture [] IN_FLASH =
 {
	0x00,0x03,0x05,0x09,0x11,0xFF,0x11,0x89,0x05,0xC3,0x00,0xE0,0x00,0xF0,0x00,0xF8,
	0x00,0x00,0x00,0x00,0x00,0x00,0x00,0x44,0x28,0xFF,0x11,0xAA,0x44,0x00,0x00,0x00,
	0x00,0x00,0x00,0x00,0x00,0x00,0x00,0x00,0x00,0x00,0x00,0x00,0x00,0x00,0x00,0x00,
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	0x00,0x00,0x26,0x49,0x49,0x49,0x32,0x00,0x00,0x7F,0x02,0x04,0x08,0x10,0x7F,0x00,
};

const uint8_t tile_empty[] PROGMEM =
{
	// bits A
	0b00000000,
	0b00000000,
	0b00000000,
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	0b00000000,
	// mask
	0b00000000,
	0b00000000,
	0b00000000,
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	0b00000000,
	// bits B
	0b00000000,
	0b00000000,
	0b00000000,
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	0b00000000,
};

const uint8_t tile_4x8[] PROGMEM =
{
  // bits A
  0b11111111,
  0b10000001,
  0b10000001,
  0b11111111,
  // mask
  0b11111111,
  0b11111111,
  0b11111111,
  0b11111111,
  // bits B
  0b11111111,
  0b10011001,
  0b10011001,
  0b11111111,
};

const uint8_t tile_triangle[] PROGMEM =
{
	// bits A
	0b00000000,
	0b01000000,
	0b01100000,
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	0b00000000,
	// mask
	0b10000000,
	0b11000000,
	0b11100000,
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	0b11111111,
	// bits B
	0b00000000,
	0b01000000,
	0b01100000,
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	0b00000000,
};

const uint8_t tile_square[] IN_FLASH =
{
  // bits A
  0b00000000,
  0b01111111,
  0b01111111,
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  0b01100000,
  // mask
  0b11111111,
  0b11111111,
  0b11111111,
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  0b11110000,
  // bits B
  0b00000000,
  0b01111110,
  0b01000010,
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  0b00000000,
};

const uint8_t tile_box_quater[] PROGMEM =
{
  // bits A
  0b00000000,
  0b01111111,
  0b01000000,
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  0b01011111,
  // mask
  0b11111111,
  0b11111111,
  0b11111111,
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  0b11111111,
  // bits B
  0b00000000,
  0b01111111,
  0b01000000,
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  0b01011111,
};

const th::render::FontData font6x8 PROGMEM =
{
	th::assets::tile_bank_font6x8, th::render::TileFlags::TF_EMPTY, 6, ' '
};

int8_t s = 2;
int8_t y = 0, dy = 1;
int8_t x = 0, dx = 1;

uint32_t saved_time;
uint8_t frame_count;
uint8_t fps;

void RenderBackground()
{
	for (uint8_t col = 0; col < 128; ++col)
	{
#if 0
  	uint16_t index = th::render::m_page * 128 + col;
  	th::render::m_renderBuffer[col] = pgm_read_byte(&picture[index]);
#else
		bool isSolid = (th::render::m_page & 0x01) ^ (col >> 3 & 0x01);
		th::render::m_renderBuffer[col] = isSolid ? ((col & 0x07) == 0 || (col & 0x07) == 7 ? 0xFF : ((col & 0x01 ^ th::render::m_oddFrame ? 0xAB : 0xD5))) : 0x00;
#endif
	}
}

//void RenderLogo(int8_t x, int8_t y)
//{
//	th::render::TileFlags tileF = 48;
//	th::render::setTileBank(th::render::TS_PROGMEM, th::boot::logo);
//	th::render::renderTile(th::render::getTileAddr(tileF, 0), tileF, x, y + 0);
//	th::render::renderTile(th::render::getTileAddr(tileF, 1), tileF, x, y + 8);
//}

void RenderSprite(uint8_t x, uint8_t y, th::render::TileFlags tileF)
{
	th::render::setTileBank(th::memory::Binary::InFLASH(tile_square));
	for (uint8_t yy = 0; yy < s; ++yy)
	{
		for (uint8_t xx = 0; xx < s; ++xx)
		{
			th::render::TileFlags flipY = (yy & 0x01) ? th::render::TF_EMPTY : th::render::TF_FLIP_Y;
			th::render::TileFlags flipX = (xx & 0x01) ? th::render::TF_FLIP_X : th::render::TF_EMPTY;
			th::render::renderTile(tileF | flipX | flipY, x + xx * 8, y + yy * 8, 0);
		}
	}
}

void RenderForeground()
{
	//	RenderLogo(x, y);
	//	th::render::flushRenderContext();

	th::render::TileFlags tileF;
	tileF |= th::render::TF_HAS_MASK;
	//	tileF |= th::render::TF_HAS_ODD_BM;
	//	tileF |= th::render::TF_TRANSPARENT;
	//	tileF |= th::render::TF_INVERSE;

	RenderSprite(x, y, tileF);

	th::render::setFontData(font6x8);
	th::render::renderText(th::render::TileFlags::TF_EMPTY, 128 - x, y + 4, "Some text!", 10);

	RenderSprite(x + 4, 64 - y, tileF);
}

void RenderFPS()
{
	uint8_t f = fps;
	th::render::setFontData(font6x8);
	for (uint8_t x = 0; x <= 12; x += 6)
	{
		th::render::renderChar(th::render::TileFlags::TF_EMPTY, 12 - x, 0, '0' + (f % 10));
		f /= 10;
	}
}

const th::render::RenderLayerCallback renderSequence[] PROGMEM =
{
	&RenderBackground,
	&RenderForeground,
	&RenderFPS,
	NULL
};

void setup()
{
	saved_time = millis();
	frame_count = 0;
	fps = 0;

	th::render::setRenderSequence(renderSequence);
}

void loop()
{
	uint32_t current_time = millis();
	if (current_time >= saved_time + 1000)
	{
		fps = frame_count;
		saved_time += 1000;
		frame_count = 0;
	}
	frame_count++;

	y += dy * 1;
	x += dx * 1;

	if (y == 0 || y == 63) dy = -dy;
	if (x == 0 || x == 127) dx = -dx;
}
