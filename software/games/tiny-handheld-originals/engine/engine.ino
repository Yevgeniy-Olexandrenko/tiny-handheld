#pragma once

#include "src/engine.h"
#include "src/assets/fonts.h"
#include "src/assets/logo.h"

const uint8_t picture [] IN_FLASH =
 {
	0x00,0x03,0x05,0x09,0x11,0xFF,0x11,0x89,0x05,0xC3,0x00,0xE0,0x00,0xF0,0x00,0xF8,
	0x00,0x00,0x00,0x00,0x00,0x00,0x00,0x44,0x28,0xFF,0x11,0xAA,0x44,0x00,0x00,0x00,
	0x00,0x00,0x00,0x00,0x00,0x00,0x00,0x00,0x00,0x00,0x00,0x00,0x00,0x00,0x00,0x00,
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	0x00,0x00,0x26,0x49,0x49,0x49,0x32,0x00,0x00,0x7F,0x02,0x04,0x08,0x10,0x7F,0x00,
};

const uint8_t tile_empty[] PROGMEM =
{
	// bits A
	0b00000000,
	0b00000000,
	0b00000000,
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	0b00000000,
	// mask
	0b00000000,
	0b00000000,
	0b00000000,
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	0b00000000,
	// bits B
	0b00000000,
	0b00000000,
	0b00000000,
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	0b00000000,
};

const uint8_t tile_4x8[] PROGMEM =
{
  // bits A
  0b11111111,
  0b10000001,
  0b10000001,
  0b11111111,
  // mask
  0b11111111,
  0b11111111,
  0b11111111,
  0b11111111,
  // bits B
  0b11111111,
  0b10011001,
  0b10011001,
  0b11111111,
};

const uint8_t tile_triangle[] PROGMEM =
{
	// bits A
	0b00000000,
	0b01000000,
	0b01100000,
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	0b00000000,
	// mask
	0b10000000,
	0b11000000,
	0b11100000,
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	0b11111111,
	// bits B
	0b00000000,
	0b01000000,
	0b01100000,
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	0b00000000,
};

const uint8_t tile_square[] IN_FLASH =
{
  // bits A
  0b00000000,
  0b01111111,
  0b01111111,
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  0b01100000,
  // mask
  0b11111111,
  0b11111111,
  0b11111111,
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  0b11110000,
  // bits B
  0b00000000,
  0b01111110,
  0b01000010,
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  0b00000000,
};

const uint8_t tile_box_quater[] PROGMEM =
{
  // bits A
  0b00000000,
  0b01111111,
  0b01000000,
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  0b01011111,
  // mask
  0b11111111,
  0b11111111,
  0b11111111,
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  0b11111111,
  // bits B
  0b00000000,
  0b01111111,
  0b01000000,
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  0b01011111,
};



int8_t s = 2;
int8_t y = 0, dy = 1;
int8_t x = 0, dx = 1;

uint32_t saved_time;
uint8_t frame_count;
uint8_t fps;

void RenderBackground()
{
#if 1
	th::video::TileFlags tileF = th::video::TF_EMPTY;
	// tileF |= th::video::TF_TRANSPARENT;
	// tileF |= th::video::TF_INVERSE;
	th::video::renderBitmap(tileF, 0, 0, 128, 64, th::memory::Binary::InFLASH(picture));
#else
	for (uint8_t col = 0; col < 128; ++col)
	{
		bool isSolid = (th::video::m_page & 0x01) ^ (col >> 3 & 0x01);
		th::video::m_renderBuffer[col] = isSolid ? ((col & 0x07) == 0 || (col & 0x07) == 7 ? 0xFF : ((col & 0x01 ^ th::video::m_oddFrame ? 0xAB : 0xD5))) : 0x00;
	}
#endif
}

void RenderSprite(uint8_t x, uint8_t y)
{
	th::video::TileFlags tileF;
	tileF |= th::video::TF_HAS_MASK;
	// tileF |= th::video::TF_HAS_ODD_BM;
	// tileF |= th::video::TF_TRANSPARENT;
	// tileF |= th::video::TF_INVERSE;

	th::video::setTileBank(th::memory::Binary::InFLASH(tile_square));
	for (uint8_t yy = 0; yy < s; ++yy)
	{
		for (uint8_t xx = 0; xx < s; ++xx)
		{
			th::video::TileFlags flipY = (yy & 0x01) ? th::video::TF_EMPTY : th::video::TF_FLIP_Y;
			th::video::TileFlags flipX = (xx & 0x01) ? th::video::TF_FLIP_X : th::video::TF_EMPTY;
			th::video::renderTile(tileF | flipX | flipY, x + xx * 8, y + yy * 8, 0);
		}
	}
}

void RenderLogo(uint8_t x, uint8_t y)
{
	th::video::TileFlags tileF;
	//tileF |= th::video::TF_TRANSPARENT;
	//tileF |= th::video::TF_INVERSE;
	th::video::renderBitmap(tileF, x, y, 48, 16, th::memory::Binary::InFLASH(th::assets::logo));
}

void RenderForeground()
{
	RenderSprite(x, y);
	RenderSomeText(128 - x, y + 4);
	RenderSprite(x + 4, 64 - y);
	RenderLogo(40, y);
}

void RenderSomeText(uint8_t x, uint8_t y)
{
	th::video::setFontData(th::assets::font6x8);
	th::video::renderText(th::video::TileFlags::TF_EMPTY, x, y, "Some text!", 10);
}

void RenderFPS()
{
	uint8_t f = fps;
	th::video::setFontData(th::assets::font6x8);
	for (uint8_t x = 0; x <= 12; x += 6)
	{
		th::video::renderChar(th::video::TileFlags::TF_EMPTY, 12 - x, 0, '0' + (f % 10));
		f /= 10;
	}
}

void RenderBattery()
{
	uint8_t bat = th::battery::getPercent();
	th::video::setFontData(th::assets::font6x8);
	for (uint8_t x = 0; x <= 12; x += 6)
	{
		th::video::renderChar(th::video::TileFlags::TF_EMPTY, 12 - x, 64-8, '0' + (bat % 10));
		bat /= 10;
	}
	th::video::renderChar(th::video::TileFlags::TF_EMPTY, 12 + 6, 64-8, '%');
}

void ClearBuffer()
{
	memset(th::video::m_renderBuffer, 0x00, 128);
}

void RenderSequence()
{
  //ClearBuffer();
	RenderBackground();
	RenderForeground();
	RenderFPS();
}

void setup()
{
	saved_time = millis();
	frame_count = 0;
	fps = 0;

	th::video::setRenderCallback(&RenderSequence);
}

void loop()
{
	uint32_t current_time = millis();
	if (current_time >= saved_time + 1000)
	{
		fps = frame_count;
		saved_time += 1000;
		frame_count = 0;
	}
	frame_count++;

	y += dy * 1;
	x += dx * 1;

	if (y == 0 || y == 63) dy = -dy;
	if (x == 0 || x == 127) dx = -dx;
}
