#pragma once

#include "engine.h"
#include "font6x8.h"

const uint8_t picture [] PROGMEM =
 {
	0x00,0x03,0x05,0x09,0x11,0xFF,0x11,0x89,0x05,0xC3,0x00,0xE0,0x00,0xF0,0x00,0xF8,
	0x00,0x00,0x00,0x00,0x00,0x00,0x00,0x44,0x28,0xFF,0x11,0xAA,0x44,0x00,0x00,0x00,
	0x00,0x00,0x00,0x00,0x00,0x00,0x00,0x00,0x00,0x00,0x00,0x00,0x00,0x00,0x00,0x00,
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	0x00,0x00,0x26,0x49,0x49,0x49,0x32,0x00,0x00,0x7F,0x02,0x04,0x08,0x10,0x7F,0x00,
};

const uint8_t tile_empty[] PROGMEM =
{
	// bits A
	0b00000000,
	0b00000000,
	0b00000000,
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	0b00000000,
	// mask
	0b00000000,
	0b00000000,
	0b00000000,
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	0b00000000,
	// bits B
	0b00000000,
	0b00000000,
	0b00000000,
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	0b00000000,
};

const uint8_t tile_4x8[] PROGMEM =
{
  // bits A
  0b11111111,
  0b10000001,
  0b10000001,
  0b11111111,
  // mask
  0b11111111,
  0b11111111,
  0b11111111,
  0b11111111,
  // bits B
  0b11111111,
  0b10011001,
  0b10011001,
  0b11111111,
};

const uint8_t tile_triangle[] PROGMEM =
{
	// bits A
	0b00000000,
	0b01000000,
	0b01100000,
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	0b00000000,
	// mask
	0b10000000,
	0b11000000,
	0b11100000,
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	0b11111111,
	// bits B
	0b00000000,
	0b01000000,
	0b01100000,
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	0b00000000,
};

const uint8_t tile_square[] PROGMEM =
{
  // bits A
  0b00000000,
  0b01111111,
  0b01111111,
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  0b01100000,
  // mask
  0b11111111,
  0b11111111,
  0b11111111,
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  0b11110000,
  // bits B
  0b00000000,
  0b01111110,
  0b01000010,
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  0b00000000,
};

const uint8_t tile_box_quater[] PROGMEM =
{
  // bits A
  0b00000000,
  0b01111111,
  0b01000000,
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  0b01011111,
  // mask
  0b11111111,
  0b11111111,
  0b11111111,
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  0b11111111,
  // bits B
  0b00000000,
  0b01111111,
  0b01000000,
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  0b01011111,
};

const th::render::FontData font6x8 PROGMEM =
{
	th::render::TS_PROGMEM, tileBank_font6x8, 6, ' '
};

int8_t s = 2;
int8_t w = 8;
int8_t y = 0, dy = 1;
int8_t x = 0, dx = 1;

void RenderBackground(th::render::RenderContext &renderContext)
{
#if 0
	uint16_t index = renderContext.page * 128 + renderContext.column;
	renderContext.bits = pgm_read_byte(&picture[index]);
#else
	bool isSolid = (renderContext.page & 0x01) ^ (renderContext.column >> 3 & 0x01);
	uint8_t& col = renderContext.column;
	renderContext.bits = isSolid ? ((col & 0x07) == 0 || (col & 0x07) == 7 ? 0xFF : ((col & 0x01 ^ renderContext.isOddFrame ? 0xAB : 0xD5))) : 0x00;
#endif
}

void RenderSprite(uint8_t x, uint8_t y, th::render::TileFlags tileF)
{
	th::render::setTileBank(th::render::TS_PROGMEM, tile_square);
	for (uint8_t yy = 0; yy < s; ++yy)
	{
		for (uint8_t xx = 0; xx < s; ++xx)
		{
			th::render::TileFlags flipY = (yy & 0x01) ? th::render::TF_EMPTY : th::render::TF_FLIP_Y;
			th::render::TileFlags flipX = (xx & 0x01) ? th::render::TF_FLIP_X : th::render::TF_EMPTY;
			th::render::renderTile(0, tileF | flipX | flipY | w, x + xx * w, y + yy * w);
		}
	}
}

void RenderForeground(th::render::RenderContext &renderContext)
{
	th::render::TileFlags tileF;
	tileF |= th::render::TF_HAS_MASK;
	//	tileF |= th::render::TF_HAS_ODD_BM;
	//	tileF |= th::render::TF_TRANSPARENT;
	//	tileF |= th::render::TF_INVERSE;

	RenderSprite(x, y, tileF);
	th::render::flushRenderContext();

	th::render::renderText(font6x8, 6, 128 - x, y + 4, "Testing!", 8);
	th::render::flushRenderContext();

	RenderSprite(x + 4, 64 - y, tileF);
}

const th::render::RenderLayerCallback renderSequence[] PROGMEM =
{
	&RenderBackground,
	&RenderForeground,
	NULL
};

void setup()
{
	th::engine::init();
	th::render::setRenderSequence(renderSequence);
}

void loop()
{
	y += dy * 1;
	x += dx * 2;

	if (y < 0)
		y = 0;
	if (y > 64 - 8)
		y = 64 - 8;
	if (x < 0)
		x = 0;
	if (x > 128 - 8)
		x = 128 - 8;

	if (y == 0 || y == 64 - s * 8)
	{
		dy = -dy;
	}
	if (x == 0 || x == 128 - s * 8)
	{
		dx = -dx;
	}

	th::render::update();
	//delay(100);
}
